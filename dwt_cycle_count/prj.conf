## CMakeLists.txt
```
# SPDX-License-Identifier: Apache-2.0

cmake_minimum_required(VERSION 3.20.0)
find_package(Zephyr REQUIRED HINTS $ENV{ZEPHYR_BASE})
project(dwt_cycle_count)

target_sources(app PRIVATE src/main.c src/profiler.c)
```

## prj.conf
```kconfig
# --- Section A)Disable unused peripherals ---
CONFIG_GPIO=n
CONFIG_SPI=n
CONFIG_PRINTK=y
CONFIG_STDOUT_CONSOLE=y
CONFIG_LOG=y
CONFIG_LOG_PRINTK=y
# --- Section A End ---
# --- Section B)Enable specific hardware ---
# STEP 4.2 - Enable floating point format specifiers
CONFIG_CBPRINTF_FP_SUPPORT=y
# CONFIG_HEAP_MEM_POOL_SIZE=16384
CONFIG_DEBUG_OPTIMIZATIONS=y    
# https://developer.nordicsemi.com/nRF_Connect_SDK/doc/latest/zephyr/develop/optimizations/footprint.html
# CONFIG_ISR_STACK_SIZE=2048
CONFIG_MAIN_STACK_SIZE=8192
# CONFIG_SYSTEM_WORKQUEUE_STACK_SIZE=1024
# CONFIG_PRIVILEGED_STACK_SIZE= 1024
CONFIG_FPU=y # Enable floating point unit hardware support
# --- Section B End ---
# Section C) Executing Time Functions
CONFIG_TIMING_FUNCTIONS=y
```

## src/main.c
```c
/*
Author : @shiva-karthick
All rights reserved.
*/
#include <zephyr/kernel.h>
#include <stdbool.h>
#include <stddef.h>
#include <stdio.h>
#include <string.h>
#include <stdlib.h>
#include <assert.h>
#include <math.h>
#include <zephyr/logging/log.h>

void enable_cycle_counter(void)
{
	DWT->CTRL |= DWT_CTRL_CYCCNTENA_Msk;
}

uint32_t read_cycle_counter(void)
{
	return DWT->CYCCNT;
}

uint8_t copyTests(uint8_t dummyVal)
{

	// !- Enable the use DWT
	// * CoreDebug->DEMCR |= 0x01000000;
	// CoreDebug->DEMCR |= CoreDebug_DEMCR_TRCENA_Msk;
	// printk("Starting DWT_CYCCNT \n");

	// volatile uint32_t cycleCount = 0xffffffff;
	uint16_t LENGTH_OF_ARRAY = 70;

	uint8_t array1[LENGTH_OF_ARRAY];
	for (uint8_t i = 0; i < LENGTH_OF_ARRAY; i++)
	{
		array1[i] = 5;
	}

	uint8_t array2[LENGTH_OF_ARRAY];
	for (uint8_t i = 0; i < LENGTH_OF_ARRAY; i++)
	{
		array2[i] = 5;
	}

	// * Reset cycle counter
	// DWT->CYCCNT = 0;
	// * DWT->CTRL |= 0x1;
	// DWT->CTRL |= DWT_CTRL_CYCCNTENA_Msk;

	for (uint8_t i = 0; i < LENGTH_OF_ARRAY; i++)
	{
		array2[i] = array1[i] * 2;
	}

	// cycleCount = DWT->CYCCNT;
	// printk("copyTests LENGTH_OF_ARRAY %i\n", LENGTH_OF_ARRAY);
	// printk("copyTests forloop cycles: %u \n", cycleCount);

	// // Reset cycle counter
	// DWT->CYCCNT = 0;
	// DWT->CTRL |= 0x1;
	// memcpy(array2, array1, sizeof array1);
	// cycleCount = DWT->CYCCNT;

	// printk("copyTests memcpy cycles: %llu", cycleCount);

	// printk("IteratingforVsStdArray std::copy cycles: %llu", cycleCount);

	return 0;
}

int main(void)
{
	profiler_start("test1");

	profiler_event("start");
	copyTests(55);
	profiler_event("end");

	profiler_stop();
	return 0;
}
```

## src/profiler.c
```c
/*
Author : @shiva-karthick
All rights reserved.
*/
//-- Includes ------------------------------------------------------------------
#include "profiler.h"

//-- Private functions prototypes ----------------------------------------------
static void dwt_init(void);
static void dwt_deinit(void);
static uint32_t dwt_get_counter(void);

//-- Private variables ---------------------------------------------------------
extern uint32_t SystemCoreClock;

static struct
{
    const char *name;
    uint32_t start_time;
    uint32_t event_time[PROFILER_EVENTS_MAX];
    const char *event_name[PROFILER_EVENTS_MAX];
    uint32_t event_count;
} profiler;

//-- Private functions ---------------------------------------------------------
static __INLINE void dwt_init()
{
    CoreDebug->DEMCR |= CoreDebug_DEMCR_TRCENA_Msk;
    DWT->CYCCNT = 0;
    DWT->CTRL |= DWT_CTRL_CYCCNTENA_Msk;
}

static __INLINE void dwt_deinit()
{
    DWT->CTRL &= ~DWT_CTRL_CYCCNTENA_Msk;
    DWT->CYCCNT = 0;
    CoreDebug->DEMCR &= ~CoreDebug_DEMCR_TRCENA_Msk;
}

static __INLINE uint32_t dwt_get_counter()
{
    return DWT->CYCCNT;
}

//-- Exported functions --------------------------------------------------------
void profiler_start(const char *name)
{
    profiler.name = name;
    profiler.event_count = 0;

    dwt_init();

    profiler.start_time = dwt_get_counter();
}

void profiler_event(const char *event)
{
    if (profiler.event_count < PROFILER_EVENTS_MAX)
    {
        profiler.event_time[profiler.event_count] = dwt_get_counter();
        profiler.event_name[profiler.event_count] = event;
        profiler.event_count += 1;
    }
}

void profiler_stop(void)
{
    uint32_t ticks_per_1us;
    uint32_t prev_time_us;
    uint32_t prev_time_ticks;
    uint32_t timestamp_us;
    uint32_t timestamp_ticks;
    uint32_t delta_us;
    uint32_t delta_ticks;

    ticks_per_1us = SystemCoreClock / 1000000;

    printf("Profiling \"%s\" sequence:\n"
           "--Event-----------------------|-timestamp_us-|----delta_us---|-timestamp_ticks-|----delta_ticks---|" PROFILER_ENDL,
           profiler.name);
    prev_time_us = 0;
    prev_time_ticks = 0;

    for (uint32_t i = 0; i < profiler.event_count; i++)
    {
        timestamp_ticks = profiler.event_time[i] - profiler.start_time;
        timestamp_us = timestamp_ticks / ticks_per_1us;
        delta_us = timestamp_us - prev_time_us;
        delta_ticks = timestamp_ticks - prev_time_ticks;
        prev_time_us = timestamp_us;
        prev_time_ticks = timestamp_ticks;
        printf("%-30s: %9d us | +%9d us | %9d ticks | +%9d ticks |" PROFILER_ENDL,
               profiler.event_name[i], (int)timestamp_us, (int)delta_us, (int)timestamp_ticks, (int)delta_ticks);
    }
    printf(PROFILER_ENDL);
    profiler.event_count = 0;
    dwt_deinit();
}
```

## src/profiler.h
```c
/*
Author : @shiva-karthick
All rights reserved.
*/
#ifndef __PROFILER_H
#define __PROFILER_H

//-- Includes ------------------------------------------------------------------
#include <stdint.h>
#include <stdio.h>
#include <zephyr/kernel.h>

//-- Exported macro ------------------------------------------------------------
#define PROFILER_EVENTS_MAX 20
#define PROFILER_ENDL "\r\n"

//-- Exported functions --------------------------------------------------------
void profiler_start(const char *name);
void profiler_event(const char *event);
void profiler_stop(void);

#endif // __PROFILER_H
```
